## boards/shields/cosmos_tb_5x6/Kconfig.shield
```kconfig
config SHIELD_COSMOS_TB_5x6_LEFT
    def_bool $(shields_list_contains,cosmos_tb_5x6_left)

config SHIELD_COSMOS_TB_5x6_RIGHT
    def_bool $(shields_list_contains,cosmos_tb_5x6_right)
```

## boards/shields/cosmos_tb_5x6/kconfig.shield
```kconfig
config SHIELD_cosmos_tb_5x6_LEFT
    def_bool $(shields_list_contains,cosmos_tb_5x6_left)

config SHIELD_cosmos_tb_5x6_RIGHT
    def_bool $(shields_list_contains,cosmos_tb_5x6_right)
```
